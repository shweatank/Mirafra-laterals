/dts-v1/;
/plugin/;

/ {
    compatible = "brcm,bcm2711";
    /* Disable default uart0 */
    fragment@0 {
        target = <&uart0>;
        __overlay__ {
            status = "disabled";
        };
    };

    /* Add our UART node */
    fragment@1 {
        target-path = "/";
        __overlay__ {
            isshika_uart: isshika_uart@fe201000 {
                compatible = "brcm,isshika-uart";
                reg = <0x0 0xfe201000 0x90>;
                status = "okay";
            };
        };
    };
};
