/dts-v1/;
/plugin/;

/ {
    compatible = "brcm,bcm2711";

    fragment@0 {
        target = <&i2c1>;
        __overlay__ {
            status = "okay";

            rpi_i2c_demo@50 {
                compatible = "jj,rpi-i2c-demo";
                reg = <0x50>;
            };
        };
    };
};
