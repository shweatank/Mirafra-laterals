/dts-v1/;
/plugin/;

/ {

        compatible = "brcm,bcm2711";

        fragment@0 {
                target = <&i2c1>;

                __overlay__ {

                        oled@3c {
                                compatible = "mycompany,ssd1306";
                                reg = <0x3c>;

                                width = <128>;
                                height = <32>;

                                status = "okay";
                        };

                };
        };

};
