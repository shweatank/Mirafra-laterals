/dts-v1/;
/plugin/;

/ {

    compatible = "brcm,bcm2711";

    fragment@0 {
        target = <&spi0>;
        __overlay__ {

            status = "okay";

            ili9225@0 {
                compatible = "ilitek,ili9225_rani";
                reg = <0>;                     // SPI CS0
                spi-max-frequency = <16000000>;

                dc-gpios = <&gpio 24 0>;       // DC pin
                reset-gpios = <&gpio 25 0>;    // RESET pin
            };
        };
    };

};
